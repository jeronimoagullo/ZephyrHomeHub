## CMakeLists.txt
```
# SPDX-License-Identifier: Apache-2.0

cmake_minimum_required(VERSION 3.20.0)
find_package(Zephyr REQUIRED HINTS $ENV{ZEPHYR_BASE})
project(coap_client)

FILE(GLOB app_sources src/main.c src/config_network.c)
target_sources(app PRIVATE ${app_sources})
target_include_directories(app PRIVATE ${ZEPHYR_BASE}/subsys/net/ip)
```

## prj.conf
```kconfig
# Increase stack memory to avoid crashes
CONFIG_MAIN_STACK_SIZE=4096

# Networking config
CONFIG_NETWORKING=y
CONFIG_NET_IPV4=y
CONFIG_NET_IPV6=y

# Get IPv4 address from DHCP
CONFIG_NET_DHCPV4=y
CONFIG_NET_CONFIG_AUTO_INIT=n
CONFIG_NET_MGMT=y
CONFIG_NET_MGMT_EVENT=y

# Network debug config
CONFIG_NET_LOG=y

# Enable Ethernet (required for WiFi)
CONFIG_NET_L2_ETHERNET=y
```

## socs/esp32s3_procpu.conf
```kconfig
CONFIG_WIFI=y
CONFIG_ESP32_WIFI_STA_AUTO_DHCPV4=y

CONFIG_NET_BUF_RX_COUNT=32
CONFIG_NET_BUF_TX_COUNT=32
CONFIG_NET_PKT_RX_COUNT=16
CONFIG_NET_PKT_TX_COUNT=16

# Use system heap (instead of runtime) for WiFi
CONFIG_ESP_WIFI_HEAP_SYSTEM=y
CONFIG_HEAP_MEM_POOL_SIZE=65536

CONFIG_NET_L2_ETHERNET=y
```

## src/main.c
```c
/**
 * @file main.c
 * @author Jerónimo Agulló Ocampos (jeronimoagullo@jeroagullo.com)
 * @brief 	This app creates a Temperature Node for ZephyrHomeHub project
 * @version 1.0
 * @date 2025-11-11
 *
 * @copyright Copyright (c) jeroagullo 2025
 *
 */

#include <zephyr/kernel.h>

#include "config_network.h"

#define LOG_LEVEL CONFIG_LOG_DEFAULT_LEVEL
#include <zephyr/logging/log.h>
LOG_MODULE_REGISTER(app, LOG_LEVEL_DBG);

int main(void)
{
	int ret = 0;

	LOG_DBG("Start basic WIFI sample Node");

    // Initialize Network
    network_init();

#ifdef CONFIG_WIFI
    // Connect to the WiFi network (blocking)
    ret = wifi_connect(WIFI_SSID, WIFI_PASSWORD);
    if (ret < 0) {
        LOG_INF("Error (%d): WiFi connection failed\r\n", ret);
        return 0;
    }
#endif

    // Wait to receive an IP address (blocking)
    wait_for_ip_addr();

	for (int i = 0; i < 50; i ++){
		LOG_INF("waiting...");
		k_msleep(5 * MSEC_PER_SEC);
	}

	LOG_DBG("Done");

	return 0;

}
```

## src/config_network.h
```c
/**
 * @brief Config Net library for Zephyr project.
 * @defgroup Config Net library 
 */

/**
 * @file config_network.h
 * @author Jeronimo Agullo (jeronimoagullo97@gmail.com)
 * @brief This library handles the Net (ethernet or WIFI) connection.
 * @version 2.0
 * @date 2022-01-11
 * 
 * @copyright Copyright (c) 2022
 * 
 * @addtogroup ConfigNetLib
 * @{
 */
#ifndef __CONFIG_NET_H__
#define __CONFIG_NET_H__

#define CONFIG_NET_WIFI_LENGTH 100
#define WIFI_SSID       CONFIG_WIFI_SSID
#define WIFI_PASSWORD   CONFIG_WIFI_PASSWORD

// Network prototypes
void network_init(void);
void wait_for_ip_addr(void);

// WIFI prototypes
int wifi_connect(char *ssid, char *psk);
int wifi_disconnect(void);

/**
 * @}
 */
#endif /*__CONFIG_NET_H__*/
```
