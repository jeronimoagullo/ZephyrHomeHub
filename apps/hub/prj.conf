## CMakeLists.txt
```
# SPDX-License-Identifier: Apache-2.0

cmake_minimum_required(VERSION 3.20.0)
find_package(Zephyr REQUIRED HINTS $ENV{ZEPHYR_BASE})
project(coap_server)

FILE(GLOB app_sources src/main.c src/config_network.c src/coap_server.c src/lvgl/*.c src/utils.c)
target_sources(app PRIVATE ${app_sources})
target_include_directories(app PRIVATE ${ZEPHYR_BASE}/subsys/net/ip)

# Support LD linker template
zephyr_linker_sources(DATA_SECTIONS sections-ram.ld)

# Support CMake linker generator
zephyr_iterable_section(
  NAME coap_resource_coap_server
  GROUP DATA_REGION ${XIP_ALIGN_WITH_INPUT}
  SUBALIGN ${CONFIG_LINKER_ITERABLE_SUBALIGN})

include(${ZEPHYR_BASE}/samples/net/common/common.cmake)
```

## Kconfig
```
mainmenu "ZephyrHomeHub Hub Configuration"

config WIFI_SSID
	string "WiFi SSID"
	default "YOUR_WIFI"
	help
	  SSID of the WiFi network to connect to.

config WIFI_PASSWORD
	string "WiFi Password"
	default "YOUR_PASSWORD"
	help
	  Password for the WiFi network.

source "Kconfig.zephyr"
```

## prj.conf
```kconfig
####################
# Networking       #
####################
CONFIG_NETWORKING=y
CONFIG_NET_IPV6=n
CONFIG_NET_IPV4=y
CONFIG_NET_UDP=y
#CONFIG_NET_ARP=y

# Get IPv4 address from DHCP
CONFIG_NET_DHCPV4=y
CONFIG_NET_CONFIG_AUTO_INIT=n
#CONFIG_NET_DHCPV4_OPTION_CALLBACKS=y
#CONFIG_DNS_RESOLVER=y
CONFIG_NET_MGMT=y
CONFIG_NET_MGMT_EVENT=y

# Generic networking options
#CONFIG_REQUIRES_FULL_LIBC=y

# Enable Ethernet
CONFIG_NET_L2_ETHERNET=y

# CoAP
CONFIG_COAP=y
CONFIG_COAP_SERVER=y
CONFIG_NET_CONFIG_SETTINGS=y

# Socket
CONFIG_NET_SOCKETS=y
CONFIG_POSIX_API=y
CONFIG_ZVFS_POLL_MAX=4

#CONFIG_COAP_SERVER_WELL_KNOWN_CORE=y
#CONFIG_COAP_WELL_KNOWN_BLOCK_WISE=n
#CONFIG_COAP_EXTENDED_OPTIONS_LEN=y
#CONFIG_COAP_EXTENDED_OPTIONS_LEN_VALUE=40


# Kernel options
CONFIG_ENTROPY_GENERATOR=y
CONFIG_TEST_RANDOM_GENERATOR=y


####################
# LVGL             #
####################
CONFIG_DISPLAY=y
CONFIG_LVGL=y
CONFIG_LV_Z_MEM_POOL_SIZE=49152
CONFIG_MAIN_STACK_SIZE=8192
CONFIG_HEAP_MEM_POOL_SIZE=16384
# it is one of the config variables that more RAM impact has
CONFIG_LV_Z_VDB_SIZE=10
# great for debugging
CONFIG_LV_USE_REFR_DEBUG=n

CONFIG_LV_USE_FLOAT=y

# Set RGB565
CONFIG_LV_COLOR_DEPTH_16=y

# Enabling Touch screen
CONFIG_INPUT=y

####################
# lv_conf.h macros #
####################
#CONFIG_LV_MEM_CUSTOM=y
CONFIG_LV_USE_LOG=y
CONFIG_LV_USE_LABEL=y
#CONFIG_LV_USE_BTN=y
CONFIG_LV_USE_IMAGE=y
#CONFIG_LV_USE_ARC=y
CONFIG_LV_FONT_MONTSERRAT_14=y
CONFIG_LV_FONT_MONTSERRAT_16=y
CONFIG_LV_FONT_MONTSERRAT_18=y
CONFIG_LV_FONT_MONTSERRAT_24=y
CONFIG_LV_FONT_MONTSERRAT_30=y
# swap byte order
CONFIG_LV_COLOR_16_SWAP=n
# Aligns draw buffers to 4 bytes
CONFIG_LV_DRAW_BUF_ALIGN=4

####################
# LOGGING          #
####################
CONFIG_LOG=y
CONFIG_NET_LOG=y

CONFIG_REQUIRES_FLOAT_PRINTF=y
```

## boards/stm32f746g_disco.conf
```kconfig
# Config STM32 LCD driver
#CONFIG_STM32_LTDC=y
#CONFIG_STM32_LTDC_RGB565=y
```

## src/main.c
```c
/**
 * @file main.c
 * @author Jeronimo Agullo (jeronimoagullo97@gmail.com)
 * @brief Main application entry point for ZephyrHomeHub - CoAP server and LVGL GUI hub.
 * @version 1.0
 * @date 2025-02-24
 * @copyright Copyright (c) 2025
 * @see https://github.com/jeroagullo
 */

#include <zephyr/logging/log.h>
LOG_MODULE_REGISTER(main, LOG_LEVEL_DBG);

#include <lvgl.h>
#include <zephyr/drivers/display.h>

#include <zephyr/kernel.h>
#include "config_network.h"
#include "utils.h"
#include "lvgl/lvgl_tabs.h"

int main(void)
{
	int ret = 0;
    const struct device *display_dev;


	LOG_INF("Start HUB");

    display_dev = DEVICE_DT_GET(DT_CHOSEN(zephyr_display));
    if (!device_is_ready(display_dev)) {
        // Log error and exit if device is not ready
        LOG_ERR("Device not ready, aborting test");
        goto quit;
    }

    // Initialize network
    network_init();

    network_connect();

    // Wait to receive an IP address (blocking)
    wait_for_ip_addr();

    // Initialize UI work queue
    ui_work_queue_init();

    LOG_INF("END OF INITIALIZATION");

    // Add display objects
    init_gui();
    display_blanking_off(display_dev);
    lv_obj_t * count_label = lv_label_create(lv_scr_act());
    lv_obj_align(count_label, LV_ALIGN_BOTTOM_LEFT, 360, 0);

    LOG_INF("Starting LVGL loop");

    // Uptime clock label
    char count_str[16] = {0};
    int64_t last_second = -1;
    struct temp_data_msg msg;

    // Setup k_poll event for message queue
    struct k_poll_event events[1] = {
        K_POLL_EVENT_INITIALIZER(K_POLL_TYPE_MSGQ_DATA_AVAILABLE,
                                 K_POLL_MODE_NOTIFY_ONLY,
                                 &temp_data_msgq),
    };

    while (1) {
        // Poll with 10ms timeout - wakes on queue data OR timeout for LVGL refresh
        ret = k_poll(events, 1, K_MSEC(10));
        
        // Reset event state for next poll
        events[0].state = K_POLL_STATE_NOT_READY;

        // Update clock only when second changes (reduce overhead)
        int64_t current_ms = k_uptime_get();
        int64_t current_sec = current_ms / 1000;
        
        if (current_sec != last_second) {
            int hours = current_sec / 3600;
            int minutes = (current_sec % 3600) / 60;
            int seconds = current_sec % 60;
            sprintf(count_str, "%02d:%02d:%02d", hours, minutes, seconds);
            lv_label_set_text(count_label, count_str);
            last_second = current_sec;
        }

        // Process all pending messages from queue (non-blocking)
        while (k_msgq_get(&temp_data_msgq, &msg, K_NO_WAIT) == 0) {
            // Log received message
            LOG_INF("Received msg from %s", msg.node_id);
            node_info_t *node = get_or_create_node(msg.node_id);
            if (!node) {
                // Log warning and skip if no free node slot
                LOG_WRN("No free node slot, dropping data from %s", msg.node_id);
                continue;
            }

            // Update current values and timestamp
            node->current_temp = msg.temperature;
            node->current_hum = msg.humidity;
            node->last_update_time = msg.timestamp;

            // Store in history ring buffer
            node->history[node->history_head].temp = msg.temperature;
            node->history[node->history_head].hum = msg.humidity;
            node->history[node->history_head].timestamp = msg.timestamp;
            node->history_head = (node->history_head + 1) % HISTORY_SIZE;
            if (node->history_count < HISTORY_SIZE)
                node->history_count++;

            // If node is new, create its widgets
            if (node->card == NULL) {
                create_node_widgets(node);
            }

            // Update UI if temperature tab is active
            if (temperature_tab_active) {
                LOG_INF("Updating node");
                update_node_display(node);
            }
        }

        // LVGL task handler - maintains smooth UI
        lv_task_handler();
    }

    return 0;

 quit:
    // Log error and exit
    LOG_ERR("quit");

    return 0;
}
```

## src/coap_server.c
```c
/**
 * @file coap_server.c
 * @author Jeronimo Agullo (jeronimoagullo97@gmail.com)
 * @brief CoAP server implementation for receiving sensor data from nodes.
 * @version 1.0
 * @date 2025-02-24
 * @copyright Copyright (c) 2025
 * @see https://github.com/jeroagullo
 */

#include <zephyr/logging/log.h>
LOG_MODULE_REGISTER(coap_server, LOG_LEVEL_DBG);

#include <zephyr/net/coap_service.h>
#include "net_sample_common.h"
#include <zephyr/net/coap_service.h>
#include <zephyr/net/coap.h> // For coap_* functions
#include <stdlib.h>

#include "utils.h"

static uint16_t coap_port = 5683;

COAP_SERVICE_DEFINE(coap_server, NULL, &coap_port, COAP_SERVICE_AUTOSTART);

/**
 * @brief Initialize and start the CoAP server.
 * @return 0 on success, negative error code on failure.
 */
int init_coap_server(){
    int ret = 0;

	ret = coap_service_start(&coap_server);
	if (ret < 0) {
		LOG_ERR("Failed to start CoAP secure server (%d)", ret);
		return ret;
	}

    LOG_INF("CoAP server started at port %d", coap_port);

    return 0;
}

/**
 * @brief POST handler for temperature node data.
 * 
 * Receives sensor data from nodes via CoAP POST request.
 * Extracts node ID from URI query and payload, then submits to UI work queue.
 * 
 * @param resource Pointer to the CoAP resource.
 * @param request Pointer to the received CoAP packet.
 * @param addr Client socket address.
 * @param addr_len Length of the socket address.
 * @return CoAP response code (COAP_RESPONSE_CODE_CREATED on success).
 */
static int temp_node_post(struct coap_resource *resource, struct coap_packet *request,
                          struct sockaddr *addr, socklen_t addr_len)
{
    uint16_t payload_len;
    const uint8_t *payload;
    char node_id[10] = {0};
    char payload_str[64];
    int ret;

    LOG_INF("Received COAP message");

    // Extract the node ID from the URI Query option (e.g., 'id=ABCD1234')
    struct coap_option query_opt;
    ret = coap_find_options(request, COAP_OPTION_URI_QUERY, &query_opt, 1);
    if (ret > 0) {
        // query_opt.value now holds the string "id=ABCD1234"
        int len = MIN(query_opt.len - 3, sizeof(node_id) - 1);
        memcpy(node_id, &query_opt.value[3], len);
        node_id[len] = '\0';
        LOG_INF("POST request from Node ID: %s", node_id);
    }

    // Extract and log the payload (sensor value)
    payload = coap_packet_get_payload(request, &payload_len);
    if (payload && payload_len > 0) {
        int len = MIN(payload_len, sizeof(payload_str) - 1);
        memcpy(payload_str, payload, len);
        payload_str[len] = '\0';
        LOG_INF("Sensor payload: %s", payload_str);
    }

    // Prepare the receive message for the queue
    struct temp_data_msg msg = {0};
    strncpy(msg.node_id, node_id, NODE_ID_LEN - 1);
    // Convert string to float
    msg.temperature = atof(payload_str);
    // Not used yet
    msg.humidity = -1.0f;
    msg.timestamp = k_uptime_get();

    // Submit work to UI work queue (thread-safe)
    ret = ui_update_submit(&msg);
    if (ret < 0) {
        LOG_WRN("Failed to submit UI update for node %s", node_id);
    }

    // Send a response back to the client
    // Returning a response code is a shortcut for sending an empty ACK
    return COAP_RESPONSE_CODE_CREATED; // Or COAP_RESPONSE_CODE_CHANGED
}

// Define the URI path for the resource
static const char * const temp_node_path[] = { "temp-node", NULL };

// Define the resource, linking it to the service and the handler
COAP_RESOURCE_DEFINE(temp_node_resource, coap_server, {
    .path = temp_node_path,
    .post = temp_node_post,
});
```

## src/config_network.c
```c
/**
 * @file config_network.c
 * @author Jeronimo Agullo (jeronimoagullo97@gmail.com)
 * @brief Network configuration and management for Ethernet and WiFi interfaces.
 * @version 2.0
 * @date 2025-02-24
 * @copyright Copyright (c) 2025
 * @see https://github.com/jeroagullo
 */

#include <string.h>
#include <zephyr/kernel.h>

#include <zephyr/net/net_if.h>
#include <zephyr/net/net_mgmt.h>

#ifdef CONFIG_WIFI
#include <zephyr/net/wifi.h>
#include <zephyr/net/wifi_mgmt.h>
#endif

#include <zephyr/logging/log.h>
LOG_MODULE_REGISTER(config_network, LOG_LEVEL_DBG);

/**
 * @brief IPv4 address obtained event callback structure.
 */
static struct net_mgmt_event_callback ipv4_cb;
static K_SEM_DEFINE(sem_ipv4, 0, 1);

#ifdef CONFIG_WIFI
/**
 * @brief WiFi connection event callback structure.
 */
static struct net_mgmt_event_callback wifi_cb;
static K_SEM_DEFINE(sem_wifi, 0, 1);

/**
 * @brief Callback handler for WiFi connection events.
 * @param cb Pointer to the event callback structure.
 * @param mgmt_event The management event type.
 * @param iface Pointer to the network interface.
 */
static void on_wifi_connection_event(struct net_mgmt_event_callback *cb,
                                     uint64_t mgmt_event,
                                     struct net_if *iface)
{
    const struct wifi_status *status = (const struct wifi_status *)cb->info;

    if (mgmt_event == NET_EVENT_WIFI_CONNECT_RESULT) {
        if (status->status) {
            LOG_ERR("Error (%d): Connection request failed", status->status);
        } else {
            LOG_INF("Connected!");
            k_sem_give(&sem_wifi);
        }
    } else if (mgmt_event == NET_EVENT_WIFI_DISCONNECT_RESULT) {
        if (status->status) {
            LOG_ERR("Error (%d): Disconnection request failed", status->status);
        } else {
            LOG_INF("Disconnected");
            k_sem_take(&sem_wifi, K_NO_WAIT);
        }
    }
}

#endif

/**
 * @brief Callback handler for IPv4 address obtained event.
 * @param cb Pointer to the event callback structure.
 * @param mgmt_event The management event type.
 * @param iface Pointer to the network interface.
 */
static void on_ipv4_obtained(struct net_mgmt_event_callback *cb,
                             uint64_t mgmt_event,
                             struct net_if *iface)
{
    // Signal that the IP address has been obtained
    if (mgmt_event == NET_EVENT_IPV4_ADDR_ADD) {
        k_sem_give(&sem_ipv4);
    }
}

/**
 * @brief Initialize network event callbacks for IPv4 and WiFi (if enabled).
 */
void network_init(void)
{

    net_mgmt_init_event_callback(&ipv4_cb,
                                 on_ipv4_obtained,
                                 NET_EVENT_IPV4_ADDR_ADD);
    net_mgmt_add_event_callback(&ipv4_cb);

#ifdef CONFIG_WIFI
    net_mgmt_init_event_callback(&wifi_cb,
                                 on_wifi_connection_event,
                                 NET_EVENT_WIFI_CONNECT_RESULT | NET_EVENT_WIFI_DISCONNECT_RESULT);
    net_mgmt_add_event_callback(&wifi_cb);
#endif

}

/**
 * @brief Wait for IP address assignment (blocking).
 * 
 * Blocks until an IPv4 address is obtained via DHCP.
 * Logs the IP address and gateway once obtained.
 */
void wait_for_ip_addr(void)
{
    struct net_if *iface;
    char ip_addr[NET_IPV4_ADDR_LEN];
    char gw_addr[NET_IPV4_ADDR_LEN];

    // Get default network interface
    iface = net_if_get_default();

    // Wait for the IPv4 address to be obtained
    LOG_INF("Waiting for IP address...");
    k_sem_take(&sem_ipv4, K_FOREVER);

    // Get the IP address
    memset(ip_addr, 0, sizeof(ip_addr));
    if (net_addr_ntop(AF_INET,
                      &iface->config.ip.ipv4->unicast[0].ipv4.address.in_addr,
                      ip_addr,
                      sizeof(ip_addr)) == NULL) {
        LOG_ERR("Error: Could not convert IP address to string");
    }

    // Get the gateway address
    memset(gw_addr, 0, sizeof(gw_addr));
    if (net_addr_ntop(AF_INET,
                      &iface->config.ip.ipv4->gw,
                      gw_addr,
                      sizeof(gw_addr)) == NULL) {
        LOG_ERR("Error: Could not convert gateway address to string");
    }

#ifdef CONFIG_WIFI
    // Get the WiFi status
    struct wifi_iface_status status;
    if (net_mgmt(NET_REQUEST_WIFI_IFACE_STATUS,
                 iface,
                 &status,
                 sizeof(struct wifi_iface_status))) {
        LOG_ERR("Error: WiFi status request failed");
    }

    LOG_INF("WiFi status:");
    if (status.state >= WIFI_STATE_ASSOCIATED) {
        LOG_INF("  SSID: %-32s", status.ssid);
        LOG_INF("  Band: %s", wifi_band_txt(status.band));
        LOG_INF("  Channel: %d", status.channel);
        LOG_INF("  Security: %s", wifi_security_txt(status.security));
        LOG_INF("  IP address: %s", ip_addr);
        LOG_INF("  Gateway: %s", gw_addr);
    }
#else
    LOG_INF("Network status:");
    LOG_INF("  IP address: %s", ip_addr);
    LOG_INF("  Gateway: %s", gw_addr);
#endif
}

/**
 * @brief Start network connection and DHCP client.
 * 
 * @return 0 on success.
 */
int network_connect(void)
{
    struct net_if *iface;

    // Get the default networking interface
    iface = net_if_get_default();

    // Start DHCP client
    net_dhcpv4_start(iface);

    return 0;
}

#ifdef CONFIG_WIFI

/**
 * @brief Connect to a WiFi network (blocking).
 * 
 * @param ssid WiFi network SSID.
 * @param psk WiFi network password (PSK).
 * 
 * @return 0 on success, negative on error.
 */
int wifi_connect(char *ssid, char *psk)
{
    int ret;
    struct net_if *iface;
    struct wifi_connect_req_params params;

    // Get the default networking interface
    iface = net_if_get_default();

    // Fill in the connection request parameters
    params.ssid = (const uint8_t *)ssid;
    params.ssid_length = strlen(ssid);
    params.psk = (const uint8_t *)psk;
    params.psk_length = strlen(psk);
    params.security = WIFI_SECURITY_TYPE_PSK;
    params.band = WIFI_FREQ_BAND_UNKNOWN;
    params.channel = WIFI_CHANNEL_ANY;
    params.mfp = WIFI_MFP_OPTIONAL;

    // Connect to the WiFi network
    ret = net_mgmt(NET_REQUEST_WIFI_CONNECT,
                   iface,
                   &params,
                   sizeof(params));

    // Start DHCP client
    net_dhcpv4_start(iface);

    LOG_INF("Connecting to WIFI...");

    // Wait for the connection to complete
    k_sem_take(&sem_wifi, K_FOREVER);

    return ret;
}

/**
 * @brief Disconnect from the current WiFi network.
 * @return 0 on success, negative on error.
 */
int wifi_disconnect(void)
{
    int ret;
    struct net_if *iface = net_if_get_default();

    ret = net_mgmt(NET_REQUEST_WIFI_DISCONNECT, iface, NULL, 0);

    return ret;
}

#endif

/**
 * @brief Get the current IPv4 address as a string.
 * @param ip_addr Buffer to store the IP address string.
 * @param len Length of the buffer.
 * @return 0 on success, -1 on error.
 */
int get_ip_address(char *ip_addr, size_t len)
{
    struct net_if *iface = net_if_get_default();
    if (iface == NULL || iface->config.ip.ipv4 == NULL) {
        return -1;
    }
    if (net_addr_ntop(AF_INET,
                      &iface->config.ip.ipv4->unicast[0].ipv4.address.in_addr,
                      ip_addr,
                      len) == NULL) {
        return -1;
    }
    return 0;
}

/**
 * @brief Get the current gateway address as a string.
 * @param gw_addr Buffer to store the gateway address string.
 * @param len Length of the buffer.
 * @return 0 on success, -1 on error.
 */
int get_gateway_address(char *gw_addr, size_t len)
{
    struct net_if *iface = net_if_get_default();
    if (iface == NULL || iface->config.ip.ipv4 == NULL) {
        return -1;
    }
    if (net_addr_ntop(AF_INET,
                      &iface->config.ip.ipv4->gw,
                      gw_addr,
                      len) == NULL) {
        return -1;
    }
    return 0;
}
```

## src/config_network.h
```c
/**
 * @brief Config Net library for Zephyr project.
 * @defgroup Config Net library 
 */

/**
 * @file config_network.h
 * @author Jeronimo Agullo (jeronimoagullo97@gmail.com)
 * @brief This library handles the Net (ethernet or WIFI) connection.
 * @version 2.0
 * @date 2022-01-11
 * 
 * @copyright Copyright (c) 2022
 * 
 * @addtogroup ConfigNetLib
 * @{
 */
#ifndef __CONFIG_NET_H__
#define __CONFIG_NET_H__

#define CONFIG_NET_WIFI_LENGTH 100
#define WIFI_SSID       CONFIG_WIFI_SSID
#define WIFI_PASSWORD   CONFIG_WIFI_PASSWORD

/**
 * @brief Initialize network event callbacks.
 */
void network_init(void);

/**
 * @brief Start network connection and DHCP client.
 * @return 0 on success.
 */
int network_connect(void);

/**
 * @brief Wait for IP address assignment (blocking).
 */
void wait_for_ip_addr(void);

/**
 * @brief Connect to a WiFi network (blocking).
 * @param ssid WiFi network SSID.
 * @param psk WiFi network password (PSK).
 * @return 0 on success, negative on error.
 */
int wifi_connect(char *ssid, char *psk);

/**
 * @brief Disconnect from the current WiFi network.
 * @return 0 on success, negative on error.
 */
int wifi_disconnect(void);

/**
 * @brief Get the current IPv4 address as a string.
 * @param ip_addr Buffer to store the IP address string.
 * @param len Length of the buffer.
 * @return 0 on success, -1 on error.
 */
int get_ip_address(char *ip_addr, size_t len);

/**
 * @brief Get the current gateway address as a string.
 * @param gw_addr Buffer to store the gateway address string.
 * @param len Length of the buffer.
 * @return 0 on success, -1 on error.
 */
int get_gateway_address(char *gw_addr, size_t len);

/**
 * @}
 */
#endif /*__CONFIG_NET_H__*/
```

## src/utils.c
```c
/**
 * @file utils.c
 * @author Jeronimo Agullo (jeronimoagullo97@gmail.com)
 * @brief Utility functions for sensor node management, message queues and work queues.
 * @version 1.0
 * @date 2025-02-24
 * @copyright Copyright (c) 2025
 * @see https://github.com/jeroagullo
 */

#include "utils.h"
#include <string.h>
#include <zephyr/logging/log.h>
#include <zephyr/kernel.h>
#include <zephyr/sys/util.h>
LOG_MODULE_REGISTER(utils, LOG_LEVEL_DBG);

K_MSGQ_DEFINE(temp_data_msgq, sizeof(struct temp_data_msg), TEMP_MSG_QUEUE_SIZE, 4);

node_info_t nodes[MAX_NODES];

// Work queue stack size and priority
#define UI_WORK_STACK_SIZE 2048
#define UI_WORK_PRIORITY 5

K_THREAD_STACK_DEFINE(ui_work_stack, UI_WORK_STACK_SIZE);
struct k_work_q ui_work_q;

// Forward declaration for work handler
static void ui_update_work_handler(struct k_work *work);

// Pool of work items to avoid dynamic allocation
#define UI_WORK_POOL_SIZE 10
static struct ui_update_work work_pool[UI_WORK_POOL_SIZE];
static bool work_pool_init = false;

/**
 * @brief Initialize the UI work queue and work item pool.
 * 
 * This function must be called once at startup before any UI updates.
 * It creates a dedicated thread for processing LVGL update work items.
 */
void ui_work_queue_init(void)
{
    // Initialize work queue
    k_work_queue_init(&ui_work_q);
    k_work_queue_start(&ui_work_q, ui_work_stack,
                      K_THREAD_STACK_SIZEOF(ui_work_stack),
                      UI_WORK_PRIORITY, NULL);
    
    // Initialize work pool
    for (int i = 0; i < UI_WORK_POOL_SIZE; i++) {
        k_work_init(&work_pool[i].work, ui_update_work_handler);
    }
    work_pool_init = true;
    LOG_INF("UI work queue initialized");
}

/**
 * @brief Enqueue a temperature data message to the message queue.
 * @param msg Pointer to the message to enqueue.
 * @return 0 on success, negative error code if queue is full.
 */
int temp_data_enqueue(struct temp_data_msg *msg)
{
    // Enqueue message to message queue
    return k_msgq_put(&temp_data_msgq, msg, K_NO_WAIT);
}

/**
 * @brief Find existing node by ID or allocate a new slot.
 * @param node_id Unique identifier string for the node.
 * @return Pointer to node_info_t, or NULL if no free slot available.
 */
node_info_t* get_or_create_node(const char *node_id) {
    // Search for existing node
    for (int i = 0; i < MAX_NODES; i++) {
        if (nodes[i].used && strcmp(nodes[i].node_id, node_id) == 0)
            return &nodes[i];
    }
    // Not found, try to allocate new slot
    for (int i = 0; i < MAX_NODES; i++) {
        if (!nodes[i].used) {
            strcpy(nodes[i].node_id, node_id);
            nodes[i].used = true;
            nodes[i].history_head = 0;
            nodes[i].history_count = 0;
            // Widgets are created later in main thread (LVGL requirement)
            return &nodes[i];
        }
    }
    // No free slot
    return NULL;
}

/**
 * @brief Work handler that processes UI updates (runs in work queue thread).
 * @param work Pointer to the work item being processed.
 */
static void ui_update_work_handler(struct k_work *work)
{
    // Get work item data
    struct ui_update_work *ui_work = CONTAINER_OF(work, struct ui_update_work, work);
    struct temp_data_msg *msg = &ui_work->data;
    
    // Enqueue to message queue for main thread to process
    int ret = temp_data_enqueue(msg);
    if (ret < 0) {
        LOG_WRN("Queue full, dropping data from node %s", msg->node_id);
    }
}

/**
 * @brief Submit UI update work to the work queue (thread-safe).
 * 
 * Called from CoAP handler or other threads to safely update the UI.
 * Uses a pre-allocated pool of work items to avoid dynamic allocation.
 * 
 * @param msg Pointer to temperature data message.
 * @return 0 if submitted successfully, negative on error.
 */
int ui_update_submit(struct temp_data_msg *msg)
{
    // Check if work queue is initialized
    if (!work_pool_init) {
        LOG_ERR("Work queue not initialized");
        return -EINVAL;
    }
    
    // Find a free work item from the pool
    for (int i = 0; i < UI_WORK_POOL_SIZE; i++) {
        if (k_work_busy_get(&work_pool[i].work) == 0) {
            // Copy message data
            memcpy(&work_pool[i].data, msg, sizeof(struct temp_data_msg));
            // Submit work
            k_work_submit_to_queue(&ui_work_q, &work_pool[i].work);
            return 0;
        }
    }
    
    LOG_WRN("Work pool exhausted, dropping data from %s", msg->node_id);
    return -ENOMEM;
}
```

## src/utils.h
```c
/**
 * @file utils.h
 * @author Jeronimo Agullo (jeronimoagullo97@gmail.com)
 * @brief Utility functions and data structures for sensor node management.
 * @version 1.0
 * @date 2025-02-24
 * @copyright Copyright (c) 2025
 * @see https://github.com/jeroagullo
 */

#ifndef UTILS_H
#define UTILS_H

#include <zephyr/kernel.h>
#include <lvgl.h>

// Maximum message queue size
#define TEMP_MSG_QUEUE_SIZE 30
#define NODE_ID_LEN 10

// Structure of the queue messages
struct temp_data_msg {
    char node_id[NODE_ID_LEN];
    float temperature;
    float humidity;
    int64_t timestamp;
};

extern struct k_msgq temp_data_msgq;

// Work queue for LVGL updates (thread-safe)
struct ui_update_work {
    struct k_work work;
    struct temp_data_msg data;
};

extern struct k_work_q ui_work_q;

// Maximum number of sensor nodes
#define MAX_NODES 6
// History size for sensor data
#define HISTORY_SIZE 60

// Sensor data point with timestamp
typedef struct {
    float temp;
    float hum;
    int64_t timestamp;
} sensor_data_t;

// Node information structure containing sensor data and LVGL widgets
typedef struct {
    char node_id[NODE_ID_LEN];
    float current_temp;
    float current_hum;
    // Timestamp of last data update
    int64_t last_update_time;
    sensor_data_t history[HISTORY_SIZE];
    // Next index to write in history ring buffer
    uint8_t history_head;
    // Number of valid entries in history
    uint8_t history_count;
    // Card container for the node
    lv_obj_t *card;
    // Node ID label (header)
    lv_obj_t *label_id;
    // Temperature label
    lv_obj_t *label_temp;
    // Humidity label
    lv_obj_t *label_hum;
    bool used;
} node_info_t;

extern node_info_t nodes[MAX_NODES];

/**
 * @brief Enqueue a temperature data message for UI update.
 * 
 * @param msg Pointer to the message to enqueue.
 * @return 0 if enqueued successfully, negative if queue is full.
 */
int temp_data_enqueue(struct temp_data_msg *msg);

/**
 * @brief Find existing node or allocate a new slot for the given node ID.
 * @param node_id Unique identifier string for the node.
 * @return Pointer to node_info_t structure, or NULL if no free slot available.
 */
node_info_t* get_or_create_node(const char *node_id);

/**
 * @brief Initialize the UI work queue (call once at startup).
 */
void ui_work_queue_init(void);

/**
 * @brief Submits UI update work to the work queue (thread-safe).
 * @param msg Pointer to temperature data message.
 * @return 0 if submitted, negative on error.
 */
int ui_update_submit(struct temp_data_msg *msg);

#endif /* UTILS_H */
```
